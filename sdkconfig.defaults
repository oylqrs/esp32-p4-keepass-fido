## sdkconfig.defaults
```kconfig
CONFIG_TINYUSB_HID_COUNT=2
CONFIG_TINYUSB_MSC_ENABLED=y
CONFIG_TINYUSB_MSC_BUFSIZE=8192
CONFIG_TINYUSB_DESC_MSC_STRING="ESP32-P4 Flash Disk"
CONFIG_FATFS_SECTOR_4096=y
CONFIG_WL_SECTOR_SIZE_4096=y
CONFIG_PARTITION_TABLE_CUSTOM=y
CONFIG_PARTITION_TABLE_CUSTOM_FILENAME="partitions.csv"
CONFIG_PARTITION_TABLE_FILENAME="partitions.csv"
CONFIG_ESPTOOLPY_FLASHMODE_DIO=y
CONFIG_ESPTOOLPY_FLASHFREQ_40M=y
CONFIG_SPI_FLASH_SUPPORT_GD_CHIP=y
CONFIG_LV_FONT_MONTSERRAT_32=y
```
